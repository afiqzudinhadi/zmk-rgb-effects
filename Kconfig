## Kconfig
```kconfig
config ZMK_RGB_EFFECT_LAYER
    bool "Per-key per-layer RGB effect"
    depends on ZMK_RGB_UNDERGLOW
    default n
    help
      Enable per-key RGB colors that change based on the active keymap layer.
      Requires the modular RGB effect API in the ZMK core (rgb-modular branch).
```
